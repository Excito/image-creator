## installimage/image.its
```
/dts-v1/;

/ {
	description = "BUBBA install image";
	#address-cells = <1>;

	images {
		kernel@1 {
			description = "bubba-2.6.34";
			data = /incbin/("./zImage");
			type = "kernel";
			arch = "arm";
			os = "linux";
			compression = "none";
			load = <0x08000>;
			entry = <0x08000>;
			hash@1 {
				algo = "md5";
			};
			hash@2 {
				algo = "sha1";
			};
		};

		ramdisk@1 {
			description = "Excito installer";
			data = /incbin/("./rootfs.ext2.gz");
			type = "ramdisk";
			arch = "arm";
			os = "linux";
			load = <0x02000000>;
			compression = "gzip";
			hash@1 {
				algo = "sha1";
			};
		};
	};

	configurations {
		default = "config@1";

		config@1 {
			description = "Excito BUBBA3 installer";
			kernel = "kernel@1";
			ramdisk = "ramdisk@1";
		};
	};
};
```
